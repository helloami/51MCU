/*
*******************************************************************************
*                     《手把手教你学51单片机(C语言版)》
*                    配套Kingst51单片机开发板 示例源代码
*
*         (c) 版权所有 2025 金沙滩工作室/清华大学出版社 保留所有权利
*                 获取更多资料请访问：http://www.kingst.org
*
* 文件名：main.c
* 描  述：第9章 蜂鸣器驱动的基础示例
* 版本号：v1.0.0
* 备  注：详情见第9章9.3节
*******************************************************************************
*/

#include <reg52.h>

sbit BUZZ = P1^6;  //蜂鸣器控制引脚

void main()
{
    EA = 1;       //使能总中断
    TMOD = 0x01;  //设置T0为模式1
    TH0  = 0xFC;  //为T0赋初值0xFC67，定时1ms
    TL0  = 0x67;
    ET0  = 1;     //使能T0中断
    TR0  = 1;     //启动T0
    BUZZ = 0;     //启动蜂鸣器鸣叫
    
    while (1);
}

/* T0中断服务函数，用于控制蜂鸣器发声 */
void InterruptTimer0() interrupt 1
{
    static unsigned int tmr = 0;

    TH0 = 0xFC;   //重新加载重载值
    TL0 = 0x67;
    tmr++;
    if (BUZZ == 0)
    {
        if (tmr >= 500)  //蜂鸣器鸣叫0.5s
        {
            BUZZ = 1;
            tmr = 0;
        }
    }
    else
    {
        if (tmr >= 1500)  //蜂鸣器关闭1.5s
        {
            BUZZ = 0;
            tmr = 0;
        }
    }
}
